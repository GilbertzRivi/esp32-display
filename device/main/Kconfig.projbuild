## device/main/Kconfig.projbuild
```kconfig
menu "Display Device Config"
    config WIFI_SSID
        string "WiFi SSID"
        default "ssid"
    config WIFI_PASSWORD
        string "WiFi Password"
        default "password"
    config HOST_URL
        string "Host base URL"
        default "http://192.168.1.100:8080"
endmenu
```

## device/sdkconfig.defaults
```kconfig
# LVGL
CONFIG_LV_COLOR_DEPTH_16=y
CONFIG_LV_MEM_SIZE_KILOBYTES=128
CONFIG_LV_FONT_UNSCII_8=y
CONFIG_LV_FONT_UNSCII_16=y

# Task watchdog — wylaczony; INT WDT (hardware lockup) pozostaje aktywny
CONFIG_ESP_TASK_WDT_EN=n

# XPT2046
CONFIG_XPT2046_Z_THRESHOLD=100
CONFIG_XPT2046_INTERRUPT_MODE=y
CONFIG_XPT2046_VREF_ON_MODE=y
CONFIG_XPT2046_CONVERT_ADC_TO_COORDS=y

# Flash
CONFIG_ESPTOOLPY_FLASHMODE_DIO=y
CONFIG_ESPTOOLPY_FLASHFREQ_80M=y
CONFIG_ESPTOOLPY_FLASHSIZE_2MB=y

# Partition table
CONFIG_PARTITION_TABLE_CUSTOM=y
CONFIG_PARTITION_TABLE_CUSTOM_FILENAME="partitions.csv"

# ESP32-S3 240MHz
CONFIG_ESP32S3_DEFAULT_CPU_FREQ_240=y

# PSRAM (ESP32-S3R8 — 8MB octal PSRAM)
# Duze alokacje (token array JSON ~40KB) trafiaja do PSRAM zamiast wewn. SRAM.
# DMA (MALLOC_CAP_DMA) zawsze wewnetrzny SRAM — LVGL/SPI bufory bezpieczne.
CONFIG_SPIRAM=y
CONFIG_SPIRAM_MODE_OCT=y
CONFIG_SPIRAM_SPEED_80M=y
CONFIG_SPIRAM_USE_MALLOC=y
CONFIG_SPIRAM_MALLOC_ALWAYSINTERNAL=16384
```
